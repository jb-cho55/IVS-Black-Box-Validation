/*@!Encoding:65001*/
includes
{
}

variables
{
  msTimer t_1ms;

  message Fault_sts_Rsp  faultRsp_msg;
  message BATT_01_10ms   battRef_msg;
  message IGN_01_2ms     ignRef_msg;
  message Fault_sts_Req  faultReq_msg;
  
  int i;
  int j;

  int time_cnt_ms = 0;
  int flag = 0;
  int Ign_switch_cnt = 0;
}

void initializeSysVar()
{
  @sysvar::Sensors::Batt_Chg_Sts   = 0;
  @sysvar::Sensors::Batt_Percent   = 0;
  @sysvar::Sensors::Batt_Voltage   = 0;

  @sysvar::Sensors::Ignition_sts   = 0;
  @sysvar::Sensors::Engine_sts     = 0;
  @sysvar::Sensors::Steering_angle = 0;

  @sysvar::Sensors::Brake_press    = 0;
  @sysvar::Sensors::ACCEL_press    = 0;
  @sysvar::Sensors::Vehicle_Speed  = 0;

  @sysvar::UDS::All_Fault_sts_request    = 1;
  @sysvar::UDS::All_Fault_clr_request    = 0;
  @sysvar::UDS::Software_Version_Request = 0;

  flag = 0;
  time_cnt_ms = 0;
  Ign_switch_cnt = 0;
  
  cancelTimer(t_1ms);
}


void clearAllFaults()
{
    @sysvar::UDS::All_Fault_clr_request = 1;
    while(1){
        @sysvar::UDS::Send_msg = 1;
        if (TestWaitForMessage(Fault_sts_Rsp, 20) == 1)
        {
            TestGetWaitEventMsgData(faultRsp_msg);
            if(faultRsp_msg.BATT_Chg_Err_sts ==0){
                break;
            }
        }
    }
    testWaitForTimeout(10);
    @sysvar::UDS::All_Fault_clr_request = 0;
}


void waitBattReference(int timeoutMs , int data)
{
  if (TestWaitForMessage(BATT_01_10ms, timeoutMs) == 1)
  {
    TestGetWaitEventMsgData(battRef_msg);
    if (battRef_msg.Batt_Percent == data){
    }
    else{
      while(1){
        if (TestWaitForMessage(BATT_01_10ms, timeoutMs) == 1){
              TestGetWaitEventMsgData(battRef_msg);
              if (battRef_msg.Batt_Percent == data){

                break;
              }
        }
      }
    }
  }
}

void waitBattChgReference(int timeoutMs , int data)
{
  if (TestWaitForMessage(BATT_01_10ms, timeoutMs) == 1)
  {
    TestGetWaitEventMsgData(battRef_msg);
    if (battRef_msg.Batt_Chg_Sts == data){
    }
    else{
      while(1){
        if (TestWaitForMessage(BATT_01_10ms, timeoutMs) == 1){
              TestGetWaitEventMsgData(battRef_msg);
              if (battRef_msg.Batt_Chg_Sts == data){
                break;
              }
        }
      }
    }
  }
}

void waitIGNReference(int timeoutMs , int data)
{
  if (TestWaitForMessage(IGN_01_2ms, timeoutMs) == 1)
  {
    TestGetWaitEventMsgData(ignRef_msg);
    if(ignRef_msg.Ignition_sts == data){
      if(ignRef_msg.Ignition_sts == 0) Ign_switch_cnt++;
    }
    else{
      while(1){
        if (TestWaitForMessage(IGN_01_2ms, timeoutMs) == 1)
        {
          TestGetWaitEventMsgData(ignRef_msg);
          if(ignRef_msg.Ignition_sts == data){
            if(ignRef_msg.Ignition_sts == 0) Ign_switch_cnt++;
            break;
          }
        }
      }
    }
  }
}
void startIvsRecoveryTimer()
{
  cancelTimer(t_1ms);
  time_cnt_ms = 0;
  testWaitForTimeout(9);   /* IVS controller 보정값 */
  setTimerCyclic(t_1ms, 1);
}

on timer t_1ms
{
  time_cnt_ms += 1;
}


testcase tc_PreCondition_Detection()
{
  int battPercent_arr[7] = {0, 1, 79, 80,81 , 99, 100};
  int battPercent;
  int idx;
  
  int faultDetectedInWindow;
  int unexpectedStateDetected;
  int timingError;
  int expectFault;
  
  for (battPercent=0; battPercent<=100; battPercent++)
  {
    for(i = 0; i <= 1; i++)
    {
      for(j = 0; j <= 1; j++)
      {
        clearAllFaults();
        cancelTimer(t_1ms);
        initializeSysVar();

        @sysvar::Sensors::Ignition_sts = i;
        @sysvar::Sensors::Engine_sts   = j;

        @sysvar::Sensors::Batt_Percent = battPercent;
        @sysvar::Sensors::Batt_Chg_Sts = 0;
        @sysvar::Sensors::Batt_Voltage = 0;

        faultDetectedInWindow = 0;
        unexpectedStateDetected = 0;
        timingError = 0;

        /* Batt_Pecent >=80 IGN=1 + ENG=1 일 때만 fault level 2 기대 */
        expectFault = (i == 1 && j == 1 && battPercent >= 80);

        waitBattReference(20, battPercent);
        cancelTimer(t_1ms);
        
        time_cnt_ms = 0;
        @sysvar::Sensors::Batt_Chg_Sts = 1;
        waitBattChgReference(20,1);
        startIvsRecoveryTimer();
        while(time_cnt_ms <= 5100)
        {
          @sysvar::UDS::Send_msg = 1;
          if(TestWaitForMessage(Fault_sts_Rsp, 20) == 1)
          {
            TestGetWaitEventMsgData(faultRsp_msg);

            if(expectFault)
            {
              if(faultRsp_msg.BATT_Chg_Err_sts == 2)
              {
                if(time_cnt_ms >= 4900 && time_cnt_ms <= 5100)
                {
                  faultDetectedInWindow = 1;
                  break;
                }
                else
                {
                  timingError = 1;
                  TestStepFail("1.4",
                               "Fault detected out of time window when IGN=%d, ENG=%d, Batt_Percent=%d, time=%dms",
                               i, j, battPercent, time_cnt_ms);
                  break;
                }
              }
            }
            else
            {
              /* fault를 기대하지 않는 모든 경우는 0 유지가 정상 */
              if(faultRsp_msg.BATT_Chg_Err_sts != 0)
              {
                unexpectedStateDetected = 1;
                TestStepFail("1.5",
                             "Unexpected state detected when IGN=%d, ENG=%d, Batt_Percent=%d, Err_sts=%d, time=%dms",
                             i, j, battPercent, faultRsp_msg.BATT_Chg_Err_sts, time_cnt_ms);
                break;
              }
            }
          }
        }

        cancelTimer(t_1ms);

        if(expectFault)
        {
          if(faultDetectedInWindow == 1)
          {
            TestStepPass("1.2",
                         "Expected fault detected in 4900~5100ms when IGN=%d, ENG=%d, Batt_Percent=%d",
                         i, j, battPercent);
          }
          else if(timingError == 0)
          {
            TestStepFail("1.1",
                         "Fault not detected in 4900~5100ms when IGN=%d, ENG=%d, Batt_Percent=%d",
                         i, j, battPercent);
          }
        }
        else
        {
          if(unexpectedStateDetected == 0)
          {
            TestStepPass("1.3",
                         "Err_sts remained 0 as expected when IGN=%d, ENG=%d, Batt_Percent=%d",
                         i, j, battPercent);
          }
        }
      }
    }
  }
}


testcase tc_Recovery()
{
  int idx;

  int recoveryBattPercent;
  int preCondOk;
  int recoveryDetectedInWindow;
  int unexpectedRecoveryDetected;
  int timingError;
  int expectRecovery;

  int battPercent_arr[7] = {0, 1, 79, 80,81 , 99, 100};
  
  for(recoveryBattPercent=0; recoveryBattPercent<=100; recoveryBattPercent++)
  {
    for(i=0; i<=1; i++){
      for(j=0; j<=1; j++){
        
        clearAllFaults();
        cancelTimer(t_1ms);
        initializeSysVar();

        preCondOk = 0;
        recoveryDetectedInWindow = 0;
        unexpectedRecoveryDetected = 0;
        timingError = 0;

        /* 1) 먼저 fault level 2 precondition 만들기 */
        @sysvar::Sensors::Ignition_sts = 1;
        @sysvar::Sensors::Engine_sts   = 1;
        @sysvar::Sensors::Batt_Percent = 81;
        @sysvar::Sensors::Batt_Chg_Sts = 1;
        @sysvar::Sensors::Batt_Voltage = 0;

        while(1)
        {
          @sysvar::UDS::Send_msg = 1;
          if(TestWaitForMessage(Fault_sts_Rsp, 20) == 1)
          {
            TestGetWaitEventMsgData(faultRsp_msg);

            if(faultRsp_msg.BATT_Chg_Err_sts == 2)
            {

                preCondOk = 1;
                break;
            }
          }
        }
        


        /* 2) recovery 조건으로 변경 */
        @sysvar::Sensors::Ignition_sts = i;
        @sysvar::Sensors::Engine_sts   = j;
        @sysvar::Sensors::Batt_Percent = recoveryBattPercent;
        @sysvar::Sensors::Batt_Chg_Sts = 0;
        @sysvar::Sensors::Batt_Voltage = 0;
        
        waitBattChgReference(20,0);
        startIvsRecoveryTimer();
        /* IGN=1, ENG=1, Batt_Percent>=80 일 때만 recovery 기대 */
        expectRecovery = (i == 1 && j == 1 && recoveryBattPercent >= 80);

        while(time_cnt_ms <= 120)
        {
          @sysvar::UDS::Send_msg = 1;

          if(TestWaitForMessage(Fault_sts_Rsp, 20) == 1)
          {
            TestGetWaitEventMsgData(faultRsp_msg);

            if(faultRsp_msg.BATT_Chg_Err_sts == 1)
            {
              if(expectRecovery)
              {
                if(time_cnt_ms >= 90 && time_cnt_ms <= 110)
                {
                  recoveryDetectedInWindow = 1;
                  break;
                }
                else
                {
                  timingError = 1;
                  TestStepFail("2.4",
                               "Recovery timing error when IGN=%d, ENG=%d, Batt_Percent=%d, time=%dms",
                               i, j, recoveryBattPercent, time_cnt_ms);
                  break;
                }
              }
              else
              {
                unexpectedRecoveryDetected = 1;
                TestStepFail("2.2",
                             "Unexpected recovery detected when IGN=%d, ENG=%d, Batt_Percent=%d, time=%dms",
                             i, j, recoveryBattPercent, time_cnt_ms);
                break;
              }
            }
          }
        }

        /* 3) 기대값 판정 */
        if(expectRecovery)
        {
          if(recoveryDetectedInWindow == 1)
          {
            TestStepPass("2.3",
                         "Recovery detected as expected when IGN=%d, ENG=%d, Batt_Percent=%d, time=%dms",
                         i, j, recoveryBattPercent,time_cnt_ms);
          }
          else if(timingError == 0)
          {
            TestStepFail("2.5",
                         "Recovery failed when IGN=%d, ENG=%d, Batt_Percent=%d",
                         i, j, recoveryBattPercent);
          }
        }
        else
        {
          if(unexpectedRecoveryDetected == 0)
          {
            TestStepPass("2.6",
                         "No recovery as expected when IGN=%d, ENG=%d, Batt_Percent=%d",
                         i, j, recoveryBattPercent);
          }
        }
      }
    }
  }
}


testcase tc_Recovery_From_NonFaultLevel2()
{
  int recoveryBattPercent;
  int preCondOk;
  int unexpectedRecovery;
  int timingError;
  
  int battPercent_arr[7] = {0, 1, 79, 80,81 , 99, 100};
  int idx;


  for (idx=0; idx<elCount(battPercent_arr); idx++)  {
    recoveryBattPercent  = battPercent_arr[idx];
    for(i = 0; i <= 1; i++)
    {
      for(j = 0; j <= 1; j++)
      {
        clearAllFaults();
        cancelTimer(t_1ms);
        initializeSysVar();

        preCondOk = 0;
        unexpectedRecovery = 0;
        timingError = 0;

        /* 1) 시작 상태가 Fault level 2가 아님을 확인 */
        @sysvar::Sensors::Ignition_sts = 1;
        @sysvar::Sensors::Engine_sts   = 1;
        @sysvar::Sensors::Batt_Percent = 79;
        @sysvar::Sensors::Batt_Chg_Sts = 1;
        @sysvar::Sensors::Batt_Voltage = 0;

        waitBattReference(20, 79);
        startIvsRecoveryTimer();
        while(time_cnt_ms <= 200)
        {
          @sysvar::UDS::Send_msg = 1;
          if(TestWaitForMessage(Fault_sts_Rsp, 20) == 1)
          {
            TestGetWaitEventMsgData(faultRsp_msg);

            if(faultRsp_msg.BATT_Chg_Err_sts != 2)
            {
              preCondOk = 1;
              break;
            }
          }
        }

        if(preCondOk == 0)
        {
          TestStepFail("3.0",
                       "Precondition failed: Fault level is still 2 before test (IGN=%d, ENG=%d, Batt_Percent=%d)",
                       i, j, recoveryBattPercent);
          continue;
        }

        /* 2) recovery 조건처럼 보이는 입력 적용 */
        cancelTimer(t_1ms);

        @sysvar::Sensors::Ignition_sts = i;
        @sysvar::Sensors::Engine_sts   = j;
        @sysvar::Sensors::Batt_Percent = recoveryBattPercent;
        @sysvar::Sensors::Batt_Chg_Sts = 0;
        @sysvar::Sensors::Batt_Voltage = 0;

        waitBattChgReference(20,0);
        startIvsRecoveryTimer();
        while(time_cnt_ms <= 110)
        {
          @sysvar::UDS::Send_msg = 1;
          if(TestWaitForMessage(Fault_sts_Rsp, 20) == 1)
          {
            TestGetWaitEventMsgData(faultRsp_msg);

            if(faultRsp_msg.BATT_Chg_Err_sts == 1)
            {
              if(time_cnt_ms >= 90 && time_cnt_ms <= 110)
              {
                unexpectedRecovery = 1;
                break;
              }
              else
              {
                timingError = 1;
                TestStepFail("3.4",
                             "Unexpected recovery timing when IGN=%d, ENG=%d, Batt_Percent=%d, time=%dms",
                             i, j, recoveryBattPercent, time_cnt_ms);
                break;
              }
            }
          }
        }

        /* 3) 기대값 판정: non-level-2에서는 모두 recovery되면 안 됨 */
        if(unexpectedRecovery == 0 && timingError == 0)
        {
          TestStepPass("3.1",
                       "No recovery as expected from non-level-2 state when IGN=%d, ENG=%d, Batt_Percent=%d",
                       i, j, recoveryBattPercent);
        }
        else if(unexpectedRecovery == 1)
        {
          TestStepFail("3.2",
                       "Unexpected recovery detected from non-level-2 state when IGN=%d, ENG=%d, Batt_Percent=%d",
                       i, j, recoveryBattPercent);
        }
      }
    }
  }
}


testcase tc_Clear_From_Level1()
{
  int preFaultOk;
  int preRecoveryOk;
  int clearAtExpectedCycle;
  int clearAtUnexpectedCycle;
  int batt_percent ;

  
  for(batt_percent =80; batt_percent <=100; batt_percent++){
    clearAllFaults();
    cancelTimer(t_1ms);
    initializeSysVar();
  
    preFaultOk = 0;
    preRecoveryOk = 0;
    clearAtExpectedCycle = 0;
    clearAtUnexpectedCycle = 0;
  
    /* 1) 먼저 Fault level 2 만들기 */
    @sysvar::Sensors::Ignition_sts = 1;
    @sysvar::Sensors::Engine_sts   = 1;
    @sysvar::Sensors::Batt_Percent = 81;
    @sysvar::Sensors::Batt_Chg_Sts = 1;
    @sysvar::Sensors::Batt_Voltage = 0;
  
    waitBattReference(20, 81);
  
    while(1)
    {
        @sysvar::UDS::Send_msg = 1;
        if(TestWaitForMessage(Fault_sts_Rsp, 20) == 1)
        {
          TestGetWaitEventMsgData(faultRsp_msg);
    
          if(faultRsp_msg.BATT_Chg_Err_sts == 2)
          {
              preFaultOk = 1;
              break;
          } 
        }
    }
  
    if(preFaultOk == 0)
    {
      TestStepFail("4.0", "Precondition fail: level 2 not reached");
      return;
    }
  
    /* 2) Recovery시켜서 Fault level 1 만들기 */
    @sysvar::Sensors::Batt_Percent = batt_percent;
    @sysvar::Sensors::Batt_Chg_Sts = 0;
    @sysvar::Sensors::Batt_Voltage = 0;
    
    cancelTimer(t_1ms);
    time_cnt_ms = 0;
    flag = 0;
  
    waitBattChgReference(20,0);
  
    while(1)
    {
      @sysvar::UDS::Send_msg =1;
      if(TestWaitForMessage(Fault_sts_Rsp, 20) == 1)
      {
        TestGetWaitEventMsgData(faultRsp_msg);
  
        if(faultRsp_msg.BATT_Chg_Err_sts == 1)
          {
            preRecoveryOk = 1;
            break;
          }
        }
    }
    
    
    if(preRecoveryOk == 0)
    {
      TestStepFail("4.0", "Precondition fail: level 1 not reached");
      return;
    }
  
    /* 3) Clear 검사 시작 전에 cycle counter만 리셋 */
    Ign_switch_cnt = 0;
    flag = 0;
  
    while(1)
    {
      if(Ign_switch_cnt > 100)
      {
        break;
      }
      
      if(@sysvar::Sensors::Ignition_sts == 0)
      {
        @sysvar::Sensors::Ignition_sts = 1;
        waitIGNReference(10, 1);
      }
      else
      {
        @sysvar::Sensors::Ignition_sts = 0;
        waitIGNReference(10, 0);
      }
      @sysvar::UDS::Send_msg =1;
      if(TestWaitForMessage(Fault_sts_Rsp, 20) == 1)
      {
        TestGetWaitEventMsgData(faultRsp_msg);
  
        if(faultRsp_msg.BATT_Chg_Err_sts == 0)
        {
          if(Ign_switch_cnt == 50)
          {
            clearAtExpectedCycle = 1;
            break;
          }
          else
          {
            clearAtUnexpectedCycle = 1;
            break;
          }
        }
      }
    }
  
    if(clearAtExpectedCycle == 1)
    {
      TestStepPass("4.1",
                   "Clear Pass: level 1 became 0 at expected cycle count, Cycle_cnt=%d, battPercent=%d",
                   Ign_switch_cnt,batt_percent);
    }
    else if(clearAtUnexpectedCycle == 1)
    {
      TestStepFail("4.2",
                   "Unexpected clear: level 1 became 0 at wrong cycle count, Cycle_cnt=%d, battPercent=%d",
                   Ign_switch_cnt,batt_percent);
    }
    else
    {
      TestStepFail("4.3",
                   "Clear Fail: level 1 did not become 0 until max cycle count, Cycle_cnt=%d, battPercent=%d",
                   Ign_switch_cnt,batt_percent);
    }    
  }

}



testcase tc_NoClear_From_Level2()
{
  int preFaultOk;
  int unexpectedClear;
  int batt_percent = 0;

  for(batt_percent = 0; batt_percent<80; batt_percent++){
    clearAllFaults();
    initializeSysVar();
  
    preFaultOk = 0;
    unexpectedClear = 0;
    
    /* 1) Fault level 2 만들기 */
    @sysvar::Sensors::Ignition_sts = 1;
    @sysvar::Sensors::Engine_sts   = 1;
    @sysvar::Sensors::Batt_Percent = 81;
    @sysvar::Sensors::Batt_Chg_Sts = 1;
    @sysvar::Sensors::Batt_Voltage = 0;
  
    waitBattReference(20, 81);
  
    while(1)
    {
      @sysvar::UDS::Send_msg =1;
      if(TestWaitForMessage(Fault_sts_Rsp, 20) == 1)
      {
        @sysvar::UDS::Send_msg =1;
        TestGetWaitEventMsgData(faultRsp_msg);
  
        if(faultRsp_msg.BATT_Chg_Err_sts == 2)
        {
  
            preFaultOk = 1;
            break;
        }
      }
    }
    
    if(preFaultOk == 0)
    {
      TestStepFail("5.0", "Precondition fail: level 2 not reached");
      return;
    }
    
    
    
    /* 2) Clear 검사 시작 전에 cycle counter 리셋 */
    Ign_switch_cnt = 0;
    flag = 0;
    @sysvar::Sensors::Ignition_sts = 1;
    @sysvar::Sensors::Engine_sts   = 1;
    @sysvar::Sensors::Batt_Percent = batt_percent;
    @sysvar::Sensors::Batt_Chg_Sts = 0;
    @sysvar::Sensors::Batt_Voltage = 0;
  
    waitBattReference(20, batt_percent);
    
    while(1)
    {
      @sysvar::UDS::Send_msg =1;
  
      if(Ign_switch_cnt > 100)
      {
        break;
      }
  
      if(@sysvar::Sensors::Ignition_sts == 0)
      {
        @sysvar::Sensors::Ignition_sts = 1;
        waitIGNReference(10, 1);
      }
      else
      {
        @sysvar::Sensors::Ignition_sts = 0;
        waitIGNReference(10, 0);
      }
  
      if(TestWaitForMessage(Fault_sts_Rsp, 20) == 1)
      {
        TestGetWaitEventMsgData(faultRsp_msg);
  
        if(faultRsp_msg.BATT_Chg_Err_sts == 0)
        {
          unexpectedClear = 1;
          break;
        }
      }
    }
  
    if(unexpectedClear == 0)
    {
      TestStepPass("5.1",
                   "Pass: level 2 was not cleared to 0 by ignition cycling, Cycle_cnt=%d, Batt_percent=%d",
                   Ign_switch_cnt,batt_percent);
    }
    else
    {
      TestStepFail("5.2",
                   "Fail: level 2 was unexpectedly cleared to 0, Cycle_cnt=%d, Batt_percent=%d",
                   Ign_switch_cnt,batt_percent);
    } 
  }
}


testcase tc_NoClear_From_Level1()
{
  int preFaultOk;
  int unexpectedClear;
  int batt_percent = 0;
  int preRecoveryOk;

  for(batt_percent = 0; batt_percent<80; batt_percent++){
    clearAllFaults();
    initializeSysVar();
    preRecoveryOk =0;
    preFaultOk = 0;
    unexpectedClear = 0;
    
    /* 1) Fault level 2 만들기 */
    @sysvar::Sensors::Ignition_sts = 1;
    @sysvar::Sensors::Engine_sts   = 1;
    @sysvar::Sensors::Batt_Percent = 81;
    @sysvar::Sensors::Batt_Chg_Sts = 1;
    @sysvar::Sensors::Batt_Voltage = 0;
  
    waitBattReference(20, 81);
  
    while(1)
    {
      @sysvar::UDS::Send_msg =1;
      if(TestWaitForMessage(Fault_sts_Rsp, 20) == 1)
      {
        @sysvar::UDS::Send_msg =1;
        TestGetWaitEventMsgData(faultRsp_msg);
  
        if(faultRsp_msg.BATT_Chg_Err_sts == 2)
        {
  
            preFaultOk = 1;
            break;
        }
      }
    }
    
    if(preFaultOk == 0)
    {
      TestStepFail("5.0", "Precondition fail: level 2 not reached");
      return;
    }
    
    /* 2) Recovery시켜서 Fault level 1 만들기 */
    @sysvar::Sensors::Batt_Percent = batt_percent;
    @sysvar::Sensors::Batt_Chg_Sts = 0;
    @sysvar::Sensors::Batt_Voltage = 0;
    
    cancelTimer(t_1ms);
    time_cnt_ms = 0;
    flag = 0;
  
    waitBattChgReference(20,0);
  
    while(1)
    {
      @sysvar::UDS::Send_msg =1;
      if(TestWaitForMessage(Fault_sts_Rsp, 20) == 1)
      {
        TestGetWaitEventMsgData(faultRsp_msg);
  
        if(faultRsp_msg.BATT_Chg_Err_sts == 1)
          {
            preRecoveryOk = 1;
            break;
          }
        }
    }
    
    
    if(preRecoveryOk == 0)
    {
      TestStepFail("4.0", "Precondition fail: level 1 not reached");
      return;
    }
    
    
    /* 3) Clear 검사 시작 전에 cycle counter 리셋 */
    Ign_switch_cnt = 0;
    flag = 0;
    @sysvar::Sensors::Ignition_sts = 1;
    @sysvar::Sensors::Engine_sts   = 1;
    @sysvar::Sensors::Batt_Percent = batt_percent;
    @sysvar::Sensors::Batt_Chg_Sts = 0;
    @sysvar::Sensors::Batt_Voltage = 0;
  
    waitBattReference(20, batt_percent);
    
    while(1)
    {
      @sysvar::UDS::Send_msg =1;
  
      if(Ign_switch_cnt > 100)
      {
        break;
      }
  
      if(@sysvar::Sensors::Ignition_sts == 0)
      {
        @sysvar::Sensors::Ignition_sts = 1;
        waitIGNReference(10, 1);
      }
      else
      {
        @sysvar::Sensors::Ignition_sts = 0;
        waitIGNReference(10, 0);
      }
  
      if(TestWaitForMessage(Fault_sts_Rsp, 20) == 1)
      {
        TestGetWaitEventMsgData(faultRsp_msg);
  
        if(faultRsp_msg.BATT_Chg_Err_sts == 0)
        {
          unexpectedClear = 1;
          break;
        }
      }
    }
  
    if(unexpectedClear == 0)
    {
      TestStepPass("5.1",
                   "Pass: level 2 was not cleared to 0 by ignition cycling, Cycle_cnt=%d, Batt_percent=%d",
                   Ign_switch_cnt,batt_percent);
    }
    else
    {
      TestStepFail("5.2",
                   "Fail: level 2 was unexpectedly cleared to 0, Cycle_cnt=%d, Batt_percent=%d",
                   Ign_switch_cnt,batt_percent);
    } 
  }
}


void MainTest()
{
  tc_PreCondition_Detection();
  tc_Recovery();
  tc_Recovery_From_NonFaultLevel2();
  tc_Clear_From_Level1();
  tc_NoClear_From_Level2();
  tc_NoClear_From_Level1();
}